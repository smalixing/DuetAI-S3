## demo/esp_joyinside/Kconfig
```kconfig
menu "ESP JoyInside Chat"

config ESP_JOYINSIDE_WS_TASK_PRIO
    int "WebSocket task priority"
    range 1 25
    default 5

config ESP_JOYINSIDE_WS_TASK_STACK
    int "WebSocket task stack size"
    range 0 65536
    default 10240

config ESP_JOYINSIDE_WS_TASK_NAME
    string "WebSocket task name override"
    default ""

config ESP_JOYINSIDE_WS_TASK_CORE_ID_SET
    bool "Pin WebSocket task to a specific core"
    default n

config ESP_JOYINSIDE_WS_TASK_CORE_ID
    int "WebSocket task core ID"
    range 0 1
    default 0
    depends on ESP_JOYINSIDE_WS_TASK_CORE_ID_SET

config ESP_JOYINSIDE_WS_BUFFER_SIZE
    int "WebSocket buffer size"
    range 1024 131072
    default 16384

config ESP_JOYINSIDE_WS_MAX_TEXT_FRAME_SIZE
    int "Maximum inbound WebSocket text frame size"
    range 1024 131072
    default 16384

config ESP_JOYINSIDE_WS_RECONNECT_TIMEOUT_MS
    int "WebSocket reconnect timeout (ms)"
    range 0 60000
    default 0

config ESP_JOYINSIDE_WS_NETWORK_TIMEOUT_MS
    int "WebSocket network timeout (ms)"
    range 1000 120000
    default 5000

config ESP_JOYINSIDE_WS_CONNECT_TIMEOUT_MS
    int "Wait for WebSocket connected timeout (ms)"
    range 1000 120000
    default 30000

config ESP_JOYINSIDE_WS_AUDIO_SEND_TIMEOUT_MS
    int "Audio uplink send timeout (ms)"
    range 1000 120000
    default 6000

config ESP_JOYINSIDE_DEBUG_TRACE_DATA
    bool "Trace JoyInside TX/RX JSON"
    default n

endmenu
```

## demo/esp_joyinside/examples/joyinside_basic_test/main/Kconfig.projbuild
```kconfig
menu "JoyInside Basic Test Example"

    config JOYINSIDE_TEST_RUN_BOOTSTRAP_DID
        bool "Run device ID generation test"
        default y

    config JOYINSIDE_TEST_RUN_BOOTSTRAP_REGISTER
        bool "Run HTTP bootstrap register test"
        default y
        depends on JOYINSIDE_TEST_ENABLE_NETWORK

    config JOYINSIDE_TEST_RUN_CHAT_CONNECT
        bool "Run WebSocket connect and init test"
        default y
        depends on JOYINSIDE_TEST_ENABLE_NETWORK

    config JOYINSIDE_TEST_ENABLE_NETWORK
        bool "Enable Wi-Fi and network-dependent tests"
        default y

    config JOYINSIDE_TEST_CHAT_DURATION_SEC
        int "Keep chat session open for N seconds after uplink audio"
        range 1 120
        default 30
        depends on JOYINSIDE_TEST_RUN_CHAT_CONNECT

    config JOYINSIDE_TEST_SEND_SILENCE
        bool "Send silence PCM frames during chat test"
        default n
        depends on JOYINSIDE_TEST_RUN_CHAT_CONNECT

    config JOYINSIDE_TEST_SEND_SPIFFS_PCM
        bool "Send SPIFFS PCM clip during chat test"
        default y
        depends on JOYINSIDE_TEST_RUN_CHAT_CONNECT

    config JOYINSIDE_TEST_SPIFFS_PCM_PATH
        string "SPIFFS PCM file path"
        default "/spiffs/story.pcm"
        depends on JOYINSIDE_TEST_SEND_SPIFFS_PCM

    config JOYINSIDE_TEST_PCM_FRAME_BYTES
        int "PCM uplink frame size in bytes"
        range 320 4096
        default 640
        depends on JOYINSIDE_TEST_RUN_CHAT_CONNECT

    config JOYINSIDE_TEST_PCM_FRAME_INTERVAL_MS
        int "Delay between PCM frames in milliseconds"
        range 0 200
        default 20
        depends on JOYINSIDE_TEST_RUN_CHAT_CONNECT

    config JOYINSIDE_ACCESS_KEY_ID
        string "JoyInside access key ID"
        default "********"

    config JOYINSIDE_ACCESS_KEY_SECRET
        string "JoyInside access key secret"
        default "*******"

    config JOYINSIDE_VENDOR_ID
        string "JoyInside vendor ID"
        default "100506"

    config JOYINSIDE_APP_ID
        string "JoyInside application ID"
        default "11112"

    config JOYINSIDE_DEVICE_MODEL
        string "JoyInside device model"
        default "LiLi_Joy"

    config JOYINSIDE_BOT_ID
        string "JoyInside bot ID override"
        default ""

    config JOYINSIDE_DEVICE_TOKEN
        string "Optional JoyInside device token"
        default ""

endmenu
```

## demo/esp_joyinside/examples/joyinside_basic_test/sdkconfig.defaults
```kconfig
CONFIG_ESP_JOYINSIDE_DEBUG_TRACE_DATA=y
CONFIG_PARTITION_TABLE_CUSTOM=y
CONFIG_PARTITION_TABLE_CUSTOM_FILENAME="partitions.csv"
```

## main/joyinside/Kconfig.projbuild
```kconfig
menu "JoyInside Cloud Voice Call"

    config JOYINSIDE_URI
        string "JoyInside WebSocket endpoint URI"
        default "wss://joyinside.jd.com/soulmate/voiceCall/v4"
        help
            WebSocket endpoint for the JD JoyInside voice-call service.

    config JOYINSIDE_ACCESS_KEY_ID
        string "Access key id"
        default ""
        help
            Application access key id issued by the JoyInside platform.

    config JOYINSIDE_ACCESS_KEY_SECRET
        string "Access key secret"
        default ""
        help
            Application access key secret used to sign auth parameters.

    config JOYINSIDE_BOT_ID
        string "Bot id"
        default ""
        help
            Robot / bot identifier bound to this device.

    config JOYINSIDE_DEVICE_TOKEN
        string "Device token"
        default ""
        help
            Device token used as the HMAC key for the device JWT.

    config JOYINSIDE_DEVICE_ID
        string "Device id (did)"
        default ""
        help
            Device id (did) reported to the platform.

endmenu
```
